## boards/shields/koZakura48/Kconfig.defconfig
```kconfig
config ZMK_SPLIT
    default y

if SHIELD_KOZAKURA48_L

config ZMK_KEYBOARD_NAME
    default "koZakura48"

config ZMK_SPLIT_ROLE_CENTRAL
    default y

endif
```

## config/west.yml
```yaml
manifest:
  remotes:
    - name: zmkfirmware
      url-base: https://github.com/zmkfirmware
    - name: sayu-hub
      url-base: https://github.com/sayu-hub
    - name: efogdev
      url-base: https://github.com/efogdev
    - name: caksoylar
      url-base: https://github.com/caksoylar  
    - name: zettaface
      url-base: https://github.com/zettaface
    - name: te9no
      url-base: https://github.com/te9no
  projects:
    - name: zmk
      remote: te9no
      revision: v0.3-branch+dya
      import: app/west.yml
    - name: zmk-pmw3610-driver
      remote: efogdev
      revision: main
    - name: zmk-rgbled-widget
      remote: caksoylar
      revision: v0.3
    - name: zmk-input-processor-keybind
      remote: zettaface
      revision: main
    - name: zmk-layout-shift
      revision: v1
      url: https://github.com/kot149/zmk-layout-shift
    - name: zmk-module-runtime-input-processor
      revision: main
      url: https://github.com/cormoran/zmk-module-runtime-input-processor
      path: modules/zmk-module-runtime-input-processor
    - name: zmk-module-battery-history
      revision: main
      url: https://github.com/cormoran/zmk-module-battery-history
      path: modules/zmk-module-battery-history
    - name: zmk-module-ble-management
      revision: main
      url: https://github.com/cormoran/zmk-module-ble-management
      path: modules/zmk-module-ble-management
    - name: zmk-module-settings-rpc
      revision: main
      url: https://github.com/cormoran/zmk-module-settings-rpc
      path: modules/zmk-module-settings-rpc
  self:
    path: config
```
